## package/audio/gmu/Config.in
```kconfig
config BR2_PACKAGE_GMU
	bool "gmu"
	select BR2_PACKAGE_SDL2
	select BR2_PACKAGE_SDL2_IMAGE
	select BR2_PACKAGE_OPUS
	select BR2_PACKAGE_MPG123
	select BR2_PACKAGE_LIBVORBIS
	select BR2_PACKAGE_FLAC
	select BR2_PACKAGE_SPEEX
	help
	  Gmu Music Player, ported from the ROCKNIX package.
	  This uses the Korean SDL2 branch from trngaje/gmu.
```

## package/emulators/ppsspp/Config.in
```kconfig
config BR2_PACKAGE_PPSSPP
	bool "ppsspp"
	depends on !BR2_PACKAGE_BATOCERA_TARGET_H700
	select BR2_PACKAGE_SDL3
	select BR2_PACKAGE_SDL3_TTF
	select BR2_PACKAGE_LIBZIP
	select BR2_PACKAGE_LIBGLEW if BR2_PACKAGE_BATOCERA_TARGET_X86_ANY
	select BR2_PACKAGE_LIBGLU  if BR2_PACKAGE_BATOCERA_TARGET_X86_ANY
	help
	  A  PSP emulator
```

## package/emulators/zesarux/Config.in
```kconfig
config BR2_PACKAGE_ZESARUX
	bool "zesarux"
	depends on BR2_TOOLCHAIN_HAS_THREADS
	select BR2_PACKAGE_SDL2
	select BR2_PACKAGE_ALSA_LIB
	help
	  ZEsarUX - ZX Second-Emulator And Released for UniX.

	  Emulates ZX Spectrum (all models), ZX80, ZX81, Sinclair QL,
	  Cambridge Z88, Jupiter Ace, Sam Coupe, Amstrad CPC, MSX,
	  Sega Master System, Colecovision, and many more.

	  Compiled with SDL2 video and audio; X11 is not required.

	  https://github.com/chernandezba/zesarux

comment "zesarux needs a toolchain w/ threads"
	depends on !BR2_TOOLCHAIN_HAS_THREADS
```

## package/modules/rtl8733bu/Config.in
```kconfig
config BR2_PACKAGE_RTL8733BU
	bool "Realtek RTL8733BU USB WiFi driver (Miyoo Flip)"
	depends on BR2_LINUX_KERNEL
	help
	  Out-of-tree Realtek RTL8733BU (USB id 0bda:b733 / 0bda:f72b) WiFi
	  vendor driver, built against the BSP kernel. Used by the Miyoo Flip.

	  The 8733B WiFi is not supported by mainline rtw88 nor by the rockchip
	  BSP; this builds the Realtek vendor driver in cfg80211 mode (wlan0 via
	  nl80211). The Bluetooth half of the chip uses in-tree btusb.
```

## package/utils/vtree/Config.in
```kconfig
config BR2_PACKAGE_VTREE
        bool "vtree"
        depends on BR2_PACKAGE_SDL2
        depends on BR2_PACKAGE_SDL2_TTF
        depends on BR2_PACKAGE_SDL2_IMAGE
        help
          Dual-pane file manager for gamepad-driven handheld Linux devices.
          Requires SDL2, SDL2_ttf, and SDL2_image.
```
